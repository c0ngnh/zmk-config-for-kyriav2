## config/west.yml
```yaml
manifest:
  remotes:
    - name: zmk-OLED-fixed
      url-base: https://github.com/c0ngnh
  projects:
    - name: zmk-OLED-fixed
      remote: zmk-OLED-fixed
      revision: main
      import: app/west.yml
  self:
    path: config
```
